#include <behaviors.dtsi>
#include <dt-bindings/zmk/keys.h>

/ {
    keymap {
        compatible = "zmk,keymap";

        default_layer {
            // 左手にA、右手にBを割り当てます
            bindings = <
                &kp A    &kp B
            >;
        };
    };
};
