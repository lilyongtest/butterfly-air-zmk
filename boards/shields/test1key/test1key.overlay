/ {
    chosen {
        zmk,kscan = &kscan0;
    };

    kscan0: kscan_composite {
        compatible = "zmk,kscan-gpio-direct";
        wakeup-source;
        label = "KSCAN";

        // P0.06ピン（Pro MicroのTXピン位置）をGND直結で反応するよう設定
        input-gpios
            = <&gpio0 6 (GPIO_ACTIVE_LOW | GPIO_PULL_UP)>
            ;
    };
};
